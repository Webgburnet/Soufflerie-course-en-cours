// File generated 21/03/2019 15:00:38
// Warning! This is a generated file, any manual changes will be
// lost during the next generation.

// object indexes into ImageControl
#CONST
    iLeddigits0     // offset 0x0
    iiLeddigits0    // offset 0x2A00
    iStatictext0    // offset 0xB200
    iStatictext1    // offset 0xC600
    iStatictext2    // offset 0xCE00
    iStatictext4    // offset 0xE000
    iStatictext5    // offset 0xF800
    iStatictext3    // offset 0x10E00
    iLeddigits4     // offset 0x11A00
    iiLeddigits4    // offset 0x17400
    iStatictext8    // offset 0x20600
    iLeddigits1     // offset 0x21200
    iiLeddigits1    // offset 0x23000
    iLeddigits2     // offset 0x2C400
    iiLeddigits2    // offset 0x2E200
    iLeddigits3     // offset 0x37600
    iiLeddigits3    // offset 0x39400
    iLeddigits5     // offset 0x42800
    iiLeddigits5    // offset 0x44600
    iLeddigits6     // offset 0x4DA00
    iiLeddigits6    // offset 0x4F800
    iLeddigits7     // offset 0x58C00
    iiLeddigits7    // offset 0x5AA00
    iLeddigits8     // offset 0x63E00
    iiLeddigits8    // offset 0x65E00
    iStatictext6    // offset 0x6FC00
    iStatictext7    // offset 0x71C00
    iLeddigits9     // offset 0x73200
    iiLeddigits9    // offset 0x75000
    iLeddigits10    // offset 0x7E400
    iiLeddigits10   // offset 0x80200
#END

#IFNOT EXISTS NOGLOBALS
var hndl ;
#ENDIF
